// -=-=-=-=-=-=-=-=-=-=-=-=-=-=-=-=-=-=-=-=-=-=-=-=-=-=-=-=-=-=-=-=-=-=-=-=- //
// 2 кнокпи и 4 светодиода. Без антидребезга
// V 1.0
// -=-=-=-=-=-=-=-=-=-=-=-=-=-=-=-=-=-=-=-=-=-=-=-=-=-=-=-=-=-=-=-=-=-=-=-=- //
#include <Arduino.h>

const int leds[4] = {7,6,5,4}; // Устанавливаем пины 4-х светодиодов
int buttons[2] = {9,8}; // Устанавливаем пины 2-х кнопок

void setup(){
  for(int i = 0; i < 4; i++){ // Настраиваем пины светодиодов как ВЫХОД
    pinMode(leds[i], OUTPUT);
  }
  for(int i = 0; i < 2; i++){ // Настраиваем пины кнопок как ВХОД с подтягивющемися резисторами
    pinMode(buttons[i], INPUT_PULLUP);
  }
}

void loop(){
  bool buttonState = true; // Переменная для хранения состояний кнопок
  for(int i = 0; i < 2; i++){ // Считываем состояние кнопок
    buttonState = digitalRead(buttons[i]);
  }
  if(buttonState == false){
    for(int i = 0; i < 4; i++){ // Включаем 4 светодиода одновременно
      digitalWrite(leds[i], HIGH);
    }
  }
  else{
    for(int i = 0; i < 4; i++){
      digitalWrite(leds[i], LOW);
    }
  }
}
// -=-=-=-=-=-=-=-=-=-=-=-=-=-=-=-=-=-=-=-=-=-=-=-=-=-=-=-=-=-=-=-=-=-=-=-=- //
// END FILE
// -=-=-=-=-=-=-=-=-=-=-=-=-=-=-=-=-=-=-=-=-=-=-=-=-=-=-=-=-=-=-=-=-=-=-=-=- //