// Управление светодиодом с монитора порта

int in1=2;  // Объявляем переменню драйвера мотора in1 на пин 2
int in2=3;  // Объявляем переменную драйвера мотора in2 на пин3

char data;  // Объявляем переменную типа char для записи в неё символьных данных

void setup()  // Область старта и настроек программы
{
  Serial.begin(9600); // Устанавливаем скорость обмена данных с монитором порта
  pinMode(in1, OUTPUT); // Настраиваем пин 1 в режим ВЫВОДА
  pinMode(in2, OUTPUT); // Настраиваем пин 2 в режим ВЫВОДА
}

void loop() // Запускаем цикл программы
{
  if (Serial.available() > 0) // Ожидаем ввод данных в монитор порта
  {
   data = Serial.read();  // Записываем данные в переменную data 
   if (data == 'R') // Сравниваем полученные данные с R. Иное игнорируем
   {
    // Двигатель крутится в право
    digitalWrite(in1, HIGH);
    digitalWrite(in2, LOW); 
    Serial.println("MOTOR RIGHT");  // Отсылаем в монитор порта сообщение
   }
   else if (data == 'L')  // Сравниваем полученные данные с L. Иное игнорируем
   {
    // Двигатель крутится в влево
    digitalWrite(in1, LOW);
    digitalWrite(in2, HIGH);
    Serial.println("MOTOR LEFT"); // Двигатель крутится в право
   }
   else if (data == 'S')  // Сравниваем полученные данные с S. Иное игнорируем
   {
    // Двигатель останавливается
    digitalWrite(in1, LOW);
    digitalWrite(in2, LOW);
    Serial.println("MOTOR OFF");  // Отсылаем в монитор порта сообщение
   }
  }
}
