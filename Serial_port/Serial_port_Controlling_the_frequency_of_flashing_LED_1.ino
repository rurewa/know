int time_pick;  // Переменная для хранения времени свечения светодиода

void setup()  // Настройка

{
  Serial.begin(9600); // Устанавливаем скорость порта связи с ПК
  pinMode(13, OUTPUT);  // Настраиваем 13 порт на вывод
  time_pick=200;  // Период свечения светодиода 0,2 сек.
}

void loop() // Основная программа

{
  char char1; // Создаём переменную для приёма значений1 или 2
  if (Serial.available() > 0) // Если поступили данные
  {
    char1 = Serial.read();  // Считываем символ
      if(char1=='1')  // Если нажата "1"
    {time_pick=1000;}  // Задержка мигания 1 сек.

       else
       {
        if(char1='2') // Если нажата "2"
        {time_pick=500;}  // Задержка мигания 0,5 сек.

        else {time_pick=100;} // Задержка мигания 0,1 сек.
        }
   }
  digitalWrite(13, 1);  // Включаем светодиод
  delay(time_pick); // Ждёт
  digitalWrite(13, 0);  // Выключает светодиод
  delay(time_pick); // Ждёт
  }
