#include <Arduino.h>
// -=-=-=-=-=-=-=-=-=-=-=-=-=-=-=-=-=-=-=-=-=-=-=-=-=-=-=-=-=-=-=-=-=-=-=-=- //
// Тест для светодиодной матрицы 8х8 MAX7219
// Вариант 0
// V 1.0
// -=-=-=-=-=-=-=-=-=-=-=-=-=-=-=-=-=-=-=-=-=-=-=-=-=-=-=-=-=-=-=-=-=-=-=-=- //

#include "LedControl.h" 
/*
 Теперь настраиваем объект LedControl.
 
 Эти номера контактов, возможно, не будут работать в вашем проекте.
 Если необходимо, поменяйте их.
 
 5-ый контакт подключен к DataIn.
 6-ый контакт подключен к CLK.
 7-ый контакт подключен к LOAD.
 У нас есть только один MAX72XX.
 */
LedControl lc=LedControl(5,6,7,1);
 
void setup()
{
  lc.shutdown(0,false);// Выключить энергосбережение, включить матрицу
  lc.setIntensity(0,8);// Устанавлить яркость (0 ~ 15 возможных значений)
  lc.clearDisplay(0);// Очистить матрицу
}
 
void loop()
{
  for (int row=0; row<8; row++)
  {
    for (int col=0; col<8; col++)
    {
      lc.setLed(0,col,row,true); // Включаем светодиодный ряд
      delay(25);
    }
  }
 
  for (int row=0; row<8; row++)
  {
    for (int col=0; col<8; col++)
    {
      lc.setLed(0,col,row,false); // Выключаем светодиодный ряд
      delay(25);
    }
  }
}
